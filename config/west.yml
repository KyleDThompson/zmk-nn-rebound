## config/west.yml
```yaml
manifest:
  remotes:
    - name: zmkfirmware
      url-base: https://github.com/zmkfirmware
    - name: PippinW
      url-base: https://github.com/PippinW
  projects:
    - name: zmk
      remote: PippinW
      revision: default_rebound
      import: app/west.yml
  self:
    path: config
```
